## west.yml
```yaml
manifest:
  version: "0.13"

  self:
    path: assureloop

  remotes:
    - name: zephyrproject-rtos
      url-base: https://github.com/zephyrproject-rtos

  projects:
    - name: zephyr
      remote: zephyrproject-rtos
      revision: v4.4.0
      import: true
```
